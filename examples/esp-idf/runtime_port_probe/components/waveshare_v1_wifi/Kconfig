## examples/esp-idf/runtime_port_probe/components/waveshare_v1_wifi/Kconfig
```kconfig
menu "TSX-LVGL Wi-Fi station"

config TSX_LVGL_WIFI_STATION_ENABLED
    bool "Enable the build-local Wi-Fi station provider"
    default n
    help
        The provider remains installed when disabled, but no association is attempted.

config TSX_LVGL_WIFI_STATION_SSID
    string "Station SSID"
    depends on TSX_LVGL_WIFI_STATION_ENABLED
    default ""

config TSX_LVGL_WIFI_STATION_PASSWORD
    string "Station password"
    depends on TSX_LVGL_WIFI_STATION_ENABLED
    default ""

endmenu
```

## examples/esp-idf/targets/waveshare_touch_amoled_1_8_v1/sdkconfig.defaults
```kconfig
CONFIG_IDF_TARGET="esp32s3"
CONFIG_ESPTOOLPY_FLASHMODE_DIO=y
CONFIG_ESPTOOLPY_FLASHFREQ_80M=y
CONFIG_ESPTOOLPY_FLASHSIZE_16MB=y
CONFIG_SPIRAM=y
CONFIG_SPIRAM_MODE_OCT=y
CONFIG_SPIRAM_SPEED_80M=y
CONFIG_FREERTOS_HZ=1000
CONFIG_ESP_DEFAULT_CPU_FREQ_MHZ_240=y
CONFIG_PARTITION_TABLE_CUSTOM=y
CONFIG_PARTITION_TABLE_CUSTOM_FILENAME="partitions.csv"
CONFIG_LV_FONT_MONTSERRAT_20=y
CONFIG_LV_FONT_MONTSERRAT_28=y
CONFIG_LV_FONT_MONTSERRAT_40=y
CONFIG_LV_FONT_MONTSERRAT_48=y
```
